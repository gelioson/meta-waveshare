## conf/layer.conf
```bitbake
# We have a conf and classes directory, add to BBPATH
BBPATH .= ":${LAYERDIR}"

# We have recipes-* directories, add to BBFILES
BBFILES += "${LAYERDIR}/recipes-*/*/*.bb \
            ${LAYERDIR}/recipes-*/*/*.bbappend"

BBFILE_COLLECTIONS += "meta-waveshare"
BBFILE_PATTERN_meta-waveshare = "^${LAYERDIR}/"
BBFILE_PRIORITY_meta-waveshare = "10"

LAYERDEPENDS_meta-waveshare = "core"
LAYERSERIES_COMPAT_meta-waveshare = "zeus dunfell"
```
